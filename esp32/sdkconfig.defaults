## esp32/sdkconfig.defaults
```kconfig
CONFIG_ESP_MAIN_TASK_STACK_SIZE=20480
CONFIG_PTHREAD_TASK_STACK_SIZE_DEFAULT=16384
CONFIG_ESP_IPC_TASK_STACK_SIZE=4096
CONFIG_FREERTOS_HZ=1000
CONFIG_ESP_TASK_WDT_TIMEOUT_S=30
CONFIG_ESP_DEFAULT_CPU_FREQ_MHZ_240=y
CONFIG_SPIRAM=y
CONFIG_SPIRAM_USE_MALLOC=y
CONFIG_SPIRAM_MALLOC_ALWAYSINTERNAL=4096
CONFIG_SPIRAM_TRY_ALLOCATE_WIFI_LWIP_FROM_SPIRAM=y
CONFIG_LWIP_MAX_SOCKETS=13
CONFIG_HTTPD_MAX_REQ_HDRS=16
CONFIG_HTTPD_MAX_URI_HANDLERS=32
CONFIG_MBEDTLS_CERTIFICATE_BUNDLE=y
CONFIG_MBEDTLS_DYNAMIC_BUFFER=y
CONFIG_ESP_HTTP_SERVER_ENABLE=y
CONFIG_SPIFFS_MAX_PARTITIONS=3
CONFIG_PARTITION_TABLE_CUSTOM=y
CONFIG_PARTITION_TABLE_CUSTOM_FILENAME="../../../../../../partitions.csv"
CONFIG_PARTITION_TABLE_OFFSET=0x8000
CONFIG_ESPTOOLPY_FLASHSIZE_16MB=y
```
